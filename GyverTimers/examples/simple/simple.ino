// Пример простой генерации прерываний аппаратным таймером
#include <GyverTimers.h>

bool FLAG_TIMER1_A = false;
bool FLAG_TIMER2_A = false;
bool LED_STATUS;

void setup() {
  LED_STATUS = digitalRead(13));        //
  Serial.begin(9600);
  Timer1.setFrequency(3);               // Высокоточный таймер 1 для первого прерывания, частота - 3 Герца
  //Timer1.setPeriod(333333);           // то же самое! Частота 3 Гц это период 333 333 микросекунд
  //Timer1.setFrequencyFloat(4.22);     // Если нужна дробная частота в Гц  
  Timer1.enableISR();                   // Запускаем прерывание (по умолч. канал А)

  // запустим второй таймер
  Timer2.setPeriod(1000000);            // Устанавливаем период таймера 1000000 мкс -> 1 гц
  Timer2.enableISR(CHANNEL_A);          // Или просто .enableISR(), запускаем прерывание на канале А таймера 2
  pinMode(13, OUTPUT);                  // будем мигать
  LED_STATUS = digitalRead(13));        // узнаём начальное состояние светодиода
  
}

void loop() {
  
  if (FLAG_TIMER1_A) {                  // Если сработал TIMER1 то 
    FLAG_TIMER1_A = false;              // сбрасываем флаг нового события от этого таймера
    Serial.println("TIMER1 сработал");  // и пишем в сериал ЗДЕСЬ!
    if (LED_STATUS)
      Serial.println("LED горит");
    else
      Serial.println("LED не горит");
  }
  
  if (FLAG_TIMER2_A) {                  // Если сработал TIMER2 то
    FLAG_TIMER2_A = false;              // сбрасываем флаг нового события от этого таймера
    Serial.println("TIMER2 сработал");  // и долго, пишем в COM-порт, по одному байту за раз :-))
    Serial.println("LED переключился");
  }
  
}

// Прерывание А таймера 1
ISR(TIMER1_A) {  
  //Serial.println("timer1");     // "использовать в прерываниях команды ввода-вывода - Это ОЧЕНЬ плохая идея
                                  //  так как эти команды сами используют прерывания, а при входе в процедуру обработки прерывания,
                                  //  устанавливается режим запрета других прерываний!
                                  //  Правильно использовать прерывания для таких целей нужно так:
  LED_STATUS = digitalRead(13));  //  Узнаём состояние светодиода,
  FLAG_TIMER1_A = true;           //  устанавливаем флаг, указывающий на то, что наступило время события, таймер сработал
                                  //  остальные, продолжительные по времени, действия выполняем в основном цикле програмы 
}

// Прерывание А таймера 2
ISR(TIMER2_A) {   // генерируем прерывания с частатой 1 гц, устанавливаем флаг и
  digitalWrite(13, !digitalRead(13)); // переключаем состояние светодиода (вкл/выкл) 
  //Serial.println("timer2");         // Здесь ситуация аналогичная
  
  FLAG_TIMER2_A = true;               // быстро устанавливаем флаг
  
}
